// Definitions for ir-gpio-recv module
/dts-v1/;
/plugin/;

/ {

        fragment@0 {
                target-path = "/";
                __overlay__ {
                        gpio_ir_tx {
                                compatible = "gpio-ir-tx";
                                status = "okay";
                                gpios = <&gpiochip_stub_341 5 0>;
                                pinctrl-names = "default";
                        };
                };
        };
};

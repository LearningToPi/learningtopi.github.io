// gpio_ir_tx bit-banging IR transmitter
/dts-v1/;
/plugin/;

/ {
	compatible = "allwinner,sun50i-h616";
	fragment@0 {
                target-path = "/";
                __overlay__ {
                        gpio_ir_tx {
                                compatible = "gpio-ir-tx";
                                status = "okay";
                                gpios = <0x31 0x2 0x8 0x0>;
                                pinctrl-names = "default";
                        };
                };
	};
};
